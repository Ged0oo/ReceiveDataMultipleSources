# file: freeRTOS_temp.ioc
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FREERTOS.BinarySemaphores01=myBinarySem01,Dynamic,NULL
FREERTOS.Tasks01=receiver,8,128,vReceiverTask,Default,NULL,Dynamic,NULL,NULL;sender1,24,128,vSenderTask,Default,NULL,Dynamic,NULL,NULL;sender2,24,128,vSenderTask,Default,NULL,Dynamic,NULL,NULL
Mcu.Family=STM32F1
Mcu.Name=STM32F103C(8-B)Tx
Mcu.Package=LQFP48
NVIC.PriorityGroup=NVIC_PRIORITYGROUP_4
PD0-OSC_IN.Mode=HSE-External-Oscillator
PD0-OSC_IN.Signal=RCC_OSC_IN
PD1-OSC_OUT.Mode=HSE-External-Oscillator
PD1-OSC_OUT.Signal=RCC_OSC_OUT
ProjectManager.HeapSize=0x200
ProjectManager.StackSize=0x400
ProjectManager.TargetToolchain=STM32CubeIDE
RCC.AHBCLKDivider=RCC_SYSCLK_DIV2
RCC.AHBFreq_Value=8000000
RCC.APB1CLKDivider=RCC_HCLK_DIV2
RCC.APB1Freq_Value=4000000
RCC.APB1TimFreq_Value=8000000
RCC.APB2Freq_Value=8000000
RCC.APB2TimFreq_Value=8000000
RCC.HCLKFreq_Value=8000000
RCC.PLLSourceVirtual=RCC_PLLSOURCE_HSE
RCC.SYSCLKFreq_VALUE=16000000
RCC.SYSCLKSource=RCC_SYSCLKSOURCE_PLLCLK
RCC.USBFreq_Value=16000000
VP_FREERTOS_VS_CMSIS_V2.Mode=CMSIS_V2
board=custom

// file: Core/Src/main.c
/* USER CODE BEGIN Header */
/**
  ******************************************************************************
  * @file           : main.c
  * @brief          : Main program body
  ******************************************************************************
  * @attention
  *
  * Copyright (c) 2023 STMicroelectronics.
  * All rights reserved.
  *
  * This software is licensed under terms that can be found in the LICENSE file
  * in the root directory of this software component.
  * If no LICENSE file comes with this software, it is provided AS-IS.
  *
  ******************************************************************************
  */
/* USER CODE END Header */
#include "main.h"
#include "cmsis_os.h"
#include "gpio.h"

void SystemClock_Config(void);
void MX_FREERTOS_Init(void);

int main(void)
{

  /* MCU Configuration--------------------------------------------------------*/

  /* Reset of all peripherals, Initializes the Flash interface and the Systick. */
  HAL_Init();

  /* USER CODE BEGIN Init */

	MRCC_voidClockInit(&RCC_obj);
	MRCC_voidPeripheralClockEnable(RCC_APB2_BUS , RCC_GPIOA_CLOCK);
	MRCC_voidPeripheralClockEnable(RCC_APB2_BUS , RCC_GPIOB_CLOCK);
	lcd_4bit_intialize(&lcd_1);

  /* USER CODE END Init */

  /* Configure the system clock */
  SystemClock_Config();

  /* Initialize all configured peripherals */
  MX_GPIO_Init();

  /* Init scheduler */
  osKernelInitialize();  /* Call init function for freertos objects (in freertos.c) */
  MX_FREERTOS_Init();

  /* Start scheduler */
  osKernelStart();

  /* We should never get here as control is now taken by the scheduler */
  /* Infinite loop */
  while (1)
  {

  }
}

void SystemClock_Config(void)
{
  RCC_OscInitTypeDef RCC_OscInitStruct = {0};
  RCC_ClkInitTypeDef RCC_ClkInitStruct = {0};

  /** Initializes the RCC Oscillators according to the specified parameters
  * in the RCC_OscInitTypeDef structure.
  */
  RCC_OscInitStruct.OscillatorType = RCC_OSCILLATORTYPE_HSE;
  RCC_OscInitStruct.HSEState = RCC_HSE_ON;
  RCC_OscInitStruct.HSEPredivValue = RCC_HSE_PREDIV_DIV1;
  RCC_OscInitStruct.HSIState = RCC_HSI_ON;
  RCC_OscInitStruct.PLL.PLLState = RCC_PLL_ON;
  RCC_OscInitStruct.PLL.PLLSource = RCC_PLLSOURCE_HSE;
  RCC_OscInitStruct.PLL.PLLMUL = RCC_PLL_MUL2;
  if (HAL_RCC_OscConfig(&RCC_OscInitStruct) != HAL_OK)
  {
    Error_Handler();
  }

  /** Initializes the CPU, AHB and APB buses clocks
  */
  RCC_ClkInitStruct.ClockType = RCC_CLOCKTYPE_HCLK|RCC_CLOCKTYPE_SYSCLK
                              |RCC_CLOCKTYPE_PCLK1|RCC_CLOCKTYPE_PCLK2;
  RCC_ClkInitStruct.SYSCLKSource = RCC_SYSCLKSOURCE_PLLCLK;
  RCC_ClkInitStruct.AHBCLKDivider = RCC_SYSCLK_DIV2;
  RCC_ClkInitStruct.APB1CLKDivider = RCC_HCLK_DIV2;
  RCC_ClkInitStruct.APB2CLKDivider = RCC_HCLK_DIV1;

  if (HAL_RCC_ClockConfig(&RCC_ClkInitStruct, FLASH_LATENCY_0) != HAL_OK)
  {
    Error_Handler();
  }
}

void Error_Handler(void)
{
  __disable_irq();
  while (1)
  {
  }
}

// file: Core/Src/freertos.c
/* USER CODE BEGIN Header */
/**
  ******************************************************************************
  * File Name          : freertos.c
  * Description        : Code for freertos applications
  ******************************************************************************
  * @attention
  *
  * Copyright (c) 2023 STMicroelectronics.
  * All rights reserved.
  *
  * This software is licensed under terms that can be found in the LICENSE file
  * in the root directory of this software component.
  * If no LICENSE file comes with this software, it is provided AS-IS.
  *
  ******************************************************************************
  */
/* USER CODE END Header */

#include "FreeRTOS.h"
#include "task.h"
#include "main.h"
#include "cmsis_os.h"

/* USER CODE BEGIN Includes */
#include "stdio.h"
#include "LCD_interface.h"
#include "queue.h"

/* USER CODE END Includes */

/* USER CODE BEGIN PTD */

typedef enum
{
	eSender1,
	eSender2
} DataSource_t;

typedef struct
{
	uint16_t ucValue;
	DataSource_t eDataSource;
} Data_t;

static Data_t xStructsToSend[2] =
{
 { 1, eSender1 }, /* Used by Sender1. */
 { 1, eSender2 } /* Used by Sender2. */
};

/* USER CODE END PTD */

/* USER CODE BEGIN Variables */

uint32_t counter=0;
QueueHandle_t  xQueueHandle1;
QueueHandle_t  xQueueHandle2;

/* USER CODE END Variables */
/* Definitions for receiver */
osThreadId_t receiverHandle;
const osThreadAttr_t receiver_attributes = {
  .name = "receiver",
  .stack_size = 128 * 4,
  .priority = (osPriority_t) osPriorityLow,
};
/* Definitions for sender1 */
osThreadId_t sender1Handle;
const osThreadAttr_t sender1_attributes = {
  .name = "sender1",
  .stack_size = 128 * 4,
  .priority = (osPriority_t) osPriorityNormal,
};
/* Definitions for sender2 */
osThreadId_t sender2Handle;
const osThreadAttr_t sender2_attributes = {
  .name = "sender2",
  .stack_size = 128 * 4,
  .priority = (osPriority_t) osPriorityNormal,
};
/* Definitions for myBinarySem01 */
osSemaphoreId_t myBinarySem01Handle;
const osSemaphoreAttr_t myBinarySem01_attributes = {
  .name = "myBinarySem01"
};

void vReceiverTask(void *argument);
void vSenderTask(void *argument);

void MX_FREERTOS_Init(void); /* (MISRA C 2004 rule 8.1) */

void MX_FREERTOS_Init(void) {

  /* Create the semaphores(s) */

  /* creation of myBinarySem01 */
  myBinarySem01Handle = osSemaphoreNew(1, 1, &myBinarySem01_attributes);

  /* USER CODE BEGIN RTOS_QUEUES */

  /* add queues, ... */
  xQueueHandle1 = xQueueCreate(3, sizeof(Data_t));

  /* USER CODE END RTOS_QUEUES */

  /* Create the thread(s) */

  /* creation of receiver */
  receiverHandle = osThreadNew(vReceiverTask, NULL, &receiver_attributes);

  /* creation of sender1 */
  sender1Handle = osThreadNew(vSenderTask, &(xStructsToSend[0]), &sender1_attributes);

  /* creation of sender2 */
  sender2Handle = osThreadNew(vSenderTask, &(xStructsToSend[1]), &sender2_attributes);

}

void vReceiverTask(void *argument)
{
	/* USER CODE BEGIN vRecieverTask */
	BaseType_t RetVal = pdTRUE;
	Data_t xReceivedStructure;
	TickType_t lastWakeTime = xTaskGetTickCount();
	/* Infinite loop */

	for(;;)
	{
		RetVal = xQueueReceive(xQueueHandle1, &xReceivedStructure, HAL_MAX_DELAY);
		if(pdTRUE == RetVal)
		{
		  osSemaphoreAcquire(myBinarySem01Handle, HAL_MAX_DELAY);

		  if (xReceivedStructure.eDataSource == eSender1)
		  {
			  lcd_4bit_send_string_pos(&lcd_1, 1, 1, "FromSender1=>");
			  LCD_WriteNumber_Position(xReceivedStructure.ucValue, 1, 15);
		  }
		  else
		  {
			  lcd_4bit_send_string_pos(&lcd_1, 2, 1, "FromSender2=>");
			  LCD_WriteNumber_Position(xReceivedStructure.ucValue, 2, 15);
		  }

		  osSemaphoreRelease(myBinarySem01Handle);
		}
		else
		{
			  LCD_Clear(&lcd_1);
			  vTaskDelayUntil(&lastWakeTime, pdMS_TO_TICKS(100));
			  lcd_4bit_send_string_pos(&lcd_1, 1, 1, "QueueRecFailed");
			  vTaskDelayUntil(&lastWakeTime, pdMS_TO_TICKS(100));
		}
	}
}

void vSenderTask(void *argument)
{
	BaseType_t RetVal = pdTRUE;
	Data_t *xSendedStructure = (Data_t *)argument;
	TickType_t lastWakeTime = xTaskGetTickCount();
	for ( ; ; )
	{
		RetVal = xQueueSendToBack(xQueueHandle1, argument, HAL_MAX_DELAY);
		if (RetVal != pdTRUE)
		{
			LCD_Clear(&lcd_1);
			vTaskDelayUntil(&lastWakeTime, pdMS_TO_TICKS(100));
			lcd_4bit_send_string_pos(&lcd_1, 1, 1, "SendingFailed");
		}
		vTaskDelayUntil(&lastWakeTime, pdMS_TO_TICKS(1000));
		xSendedStructure->ucValue++;
	}
}

/* USER CODE BEGIN Application */
/* Task to be created. */

/* USER CODE END Application */
